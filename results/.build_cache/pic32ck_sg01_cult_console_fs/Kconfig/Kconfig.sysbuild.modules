## results/run_2026-07-23_23-30-28/build/cdc_acm_bridge_hs/Kconfig/soc/Kconfig.defconfig
```kconfig
# Load Zephyr SoC defconfig descriptions.
osource "D:/ZephyrProject/mchp_zephyrproject/zephyr/soc/xlnx/zynqmp/Kconfig.defconfig"
osource "D:/ZephyrProject/mchp_zephyrproject/zephyr/soc/xlnx/zynq7000/Kconfig.defconfig"
osource "D:/ZephyrProject/mchp_zephyrproject/zephyr/soc/xlnx/versalnet/Kconfig.defconfig"
osource "D:/ZephyrProject/mchp_zephyrproject/zephyr/soc/xlnx/versal2/Kconfig.defconfig"
osource "D:/ZephyrProject/mchp_zephyrproject/zephyr/soc/xlnx/versal/Kconfig.defconfig"
osource "D:/ZephyrProject/mchp_zephyrproject/zephyr/soc/xen/Kconfig.defconfig"
osource "D:/ZephyrProject/mchp_zephyrproject/zephyr/soc/wch/ch32v/Kconfig.defconfig"
osource "D:/ZephyrProject/mchp_zephyrproject/zephyr/soc/ti/simplelink/Kconfig.defconfig"
osource "D:/ZephyrProject/mchp_zephyrproject/zephyr/soc/ti/mspm0/Kconfig.defconfig"
osource "D:/ZephyrProject/mchp_zephyrproject/zephyr/soc/ti/lm3s6965/Kconfig.defconfig"
osource "D:/ZephyrProject/mchp_zephyrproject/zephyr/soc/ti/k3/Kconfig.defconfig"
osource "D:/ZephyrProject/mchp_zephyrproject/zephyr/soc/telink/tlsr/Kconfig.defconfig"
osource "D:/ZephyrProject/mchp_zephyrproject/zephyr/soc/syna/sr100/Kconfig.defconfig"
osource "D:/ZephyrProject/mchp_zephyrproject/zephyr/soc/starfive/jh71xx/Kconfig.defconfig"
osource "D:/ZephyrProject/mchp_zephyrproject/zephyr/soc/st/stm32/Kconfig.defconfig"
osource "D:/ZephyrProject/mchp_zephyrproject/zephyr/soc/snps/qemu_arc/Kconfig.defconfig"
osource "D:/ZephyrProject/mchp_zephyrproject/zephyr/soc/snps/nsim/arc_v/Kconfig.defconfig"
osource "D:/ZephyrProject/mchp_zephyrproject/zephyr/soc/snps/nsim/arc_classic/Kconfig.defconfig"
osource "D:/ZephyrProject/mchp_zephyrproject/zephyr/soc/snps/hsdk4xd/Kconfig.defconfig"
osource "D:/ZephyrProject/mchp_zephyrproject/zephyr/soc/snps/hsdk/Kconfig.defconfig"
osource "D:/ZephyrProject/mchp_zephyrproject/zephyr/soc/snps/emsk/Kconfig.defconfig"
osource "D:/ZephyrProject/mchp_zephyrproject/zephyr/soc/snps/emsdp/Kconfig.defconfig"
osource "D:/ZephyrProject/mchp_zephyrproject/zephyr/soc/snps/arc_iot/Kconfig.defconfig"
osource "D:/ZephyrProject/mchp_zephyrproject/zephyr/soc/silabs/Kconfig.defconfig"
osource "D:/ZephyrProject/mchp_zephyrproject/zephyr/soc/sifli/sf32/Kconfig.defconfig"
osource "D:/ZephyrProject/mchp_zephyrproject/zephyr/soc/sifive/sifive_freedom/Kconfig.defconfig"
osource "D:/ZephyrProject/mchp_zephyrproject/zephyr/soc/sensry/Kconfig.defconfig"
osource "D:/ZephyrProject/mchp_zephyrproject/zephyr/soc/rockchip/Kconfig.defconfig"
osource "D:/ZephyrProject/mchp_zephyrproject/zephyr/soc/renode/riscv_virtual/Kconfig.defconfig"
osource "D:/ZephyrProject/mchp_zephyrproject/zephyr/soc/renode/cortex_r8_virtual/Kconfig.defconfig"
osource "D:/ZephyrProject/mchp_zephyrproject/zephyr/soc/renesas/smartbond/Kconfig.defconfig"
osource "D:/ZephyrProject/mchp_zephyrproject/zephyr/soc/renesas/rz/Kconfig.defconfig"
osource "D:/ZephyrProject/mchp_zephyrproject/zephyr/soc/renesas/rx/Kconfig.defconfig"
osource "D:/ZephyrProject/mchp_zephyrproject/zephyr/soc/renesas/rcar/Kconfig.defconfig"
osource "D:/ZephyrProject/mchp_zephyrproject/zephyr/soc/renesas/ra/Kconfig.defconfig"
osource "D:/ZephyrProject/mchp_zephyrproject/zephyr/soc/realtek/fingerprint/Kconfig.defconfig"
osource "D:/ZephyrProject/mchp_zephyrproject/zephyr/soc/realtek/ec/Kconfig.defconfig"
osource "D:/ZephyrProject/mchp_zephyrproject/zephyr/soc/realtek/bee/Kconfig.defconfig"
osource "D:/ZephyrProject/mchp_zephyrproject/zephyr/soc/realtek/ameba/Kconfig.defconfig"
osource "D:/ZephyrProject/mchp_zephyrproject/zephyr/soc/raspberrypi/rpi_pico/Kconfig.defconfig"
osource "D:/ZephyrProject/mchp_zephyrproject/zephyr/soc/quicklogic/eos_s3/Kconfig.defconfig"
osource "D:/ZephyrProject/mchp_zephyrproject/zephyr/soc/qemu/virt_riscv/Kconfig.defconfig"
osource "D:/ZephyrProject/mchp_zephyrproject/zephyr/soc/qemu/or1k/Kconfig.defconfig"
osource "D:/ZephyrProject/mchp_zephyrproject/zephyr/soc/qemu/malta/Kconfig.defconfig"
osource "D:/ZephyrProject/mchp_zephyrproject/zephyr/soc/openisa/rv32m1/Kconfig.defconfig"
osource "D:/ZephyrProject/mchp_zephyrproject/zephyr/soc/openhwgroup/cva6/Kconfig.defconfig"
osource "D:/ZephyrProject/mchp_zephyrproject/zephyr/soc/oct/osd32mp15x/Kconfig.defconfig"
osource "D:/ZephyrProject/mchp_zephyrproject/zephyr/soc/nxp/s32/Kconfig.defconfig"
osource "D:/ZephyrProject/mchp_zephyrproject/zephyr/soc/nxp/rw/Kconfig.defconfig"
osource "D:/ZephyrProject/mchp_zephyrproject/zephyr/soc/nxp/mcx/Kconfig.defconfig"
osource "D:/ZephyrProject/mchp_zephyrproject/zephyr/soc/nxp/lpc/Kconfig.defconfig"
osource "D:/ZephyrProject/mchp_zephyrproject/zephyr/soc/nxp/layerscape/Kconfig.defconfig"
osource "D:/ZephyrProject/mchp_zephyrproject/zephyr/soc/nxp/kinetis/Kconfig.defconfig"
osource "D:/ZephyrProject/mchp_zephyrproject/zephyr/soc/nxp/imxrt/Kconfig.defconfig"
osource "D:/ZephyrProject/mchp_zephyrproject/zephyr/soc/nxp/imx/Kconfig.defconfig"
osource "D:/ZephyrProject/mchp_zephyrproject/zephyr/soc/nuvoton/numicro/Kconfig.defconfig"
osource "D:/ZephyrProject/mchp_zephyrproject/zephyr/soc/nuvoton/numaker/Kconfig.defconfig"
osource "D:/ZephyrProject/mchp_zephyrproject/zephyr/soc/nuvoton/npcx/Kconfig.defconfig"
osource "D:/ZephyrProject/mchp_zephyrproject/zephyr/soc/nuvoton/npcm/Kconfig.defconfig"
osource "D:/ZephyrProject/mchp_zephyrproject/zephyr/soc/nordic/Kconfig.defconfig"
osource "D:/ZephyrProject/mchp_zephyrproject/zephyr/soc/neorv32/Kconfig.defconfig"
osource "D:/ZephyrProject/mchp_zephyrproject/zephyr/soc/native/inf_clock/Kconfig.defconfig"
osource "D:/ZephyrProject/mchp_zephyrproject/zephyr/soc/microchip/sam/sama7/Kconfig.defconfig"
osource "D:/ZephyrProject/mchp_zephyrproject/zephyr/soc/microchip/sam/sam_d5x_e5x/Kconfig.defconfig"
osource "D:/ZephyrProject/mchp_zephyrproject/zephyr/soc/microchip/sam/sam9/Kconfig.defconfig"
osource "D:/ZephyrProject/mchp_zephyrproject/zephyr/soc/microchip/pic64/Kconfig.defconfig"
osource "D:/ZephyrProject/mchp_zephyrproject/zephyr/soc/microchip/pic32c/pic32cz_ca/Kconfig.defconfig"
osource "D:/ZephyrProject/mchp_zephyrproject/zephyr/soc/microchip/pic32c/pic32cx_sg/Kconfig.defconfig"
osource "D:/ZephyrProject/mchp_zephyrproject/zephyr/soc/microchip/pic32c/pic32cm_sg_gc/Kconfig.defconfig"
osource "D:/ZephyrProject/mchp_zephyrproject/zephyr/soc/microchip/pic32c/pic32cm_pl/Kconfig.defconfig"
osource "D:/ZephyrProject/mchp_zephyrproject/zephyr/soc/microchip/pic32c/pic32cm_jh/Kconfig.defconfig"
osource "D:/ZephyrProject/mchp_zephyrproject/zephyr/soc/microchip/pic32c/pic32ck_sg_gc/Kconfig.defconfig"
osource "D:/ZephyrProject/mchp_zephyrproject/zephyr/soc/microchip/miv/Kconfig.defconfig"
osource "D:/ZephyrProject/mchp_zephyrproject/zephyr/soc/microchip/mec/Kconfig.defconfig"
osource "D:/ZephyrProject/mchp_zephyrproject/zephyr/soc/mediatek/mt8xxx/Kconfig.defconfig"
osource "D:/ZephyrProject/mchp_zephyrproject/zephyr/soc/lowrisc/opentitan/Kconfig.defconfig"
osource "D:/ZephyrProject/mchp_zephyrproject/zephyr/soc/litex/litex_vexriscv/Kconfig.defconfig"
osource "D:/ZephyrProject/mchp_zephyrproject/zephyr/soc/ite/ec/Kconfig.defconfig"
osource "D:/ZephyrProject/mchp_zephyrproject/zephyr/soc/intel/wildcat_lake/Kconfig.defconfig"
osource "D:/ZephyrProject/mchp_zephyrproject/zephyr/soc/intel/raptor_lake/Kconfig.defconfig"
osource "D:/ZephyrProject/mchp_zephyrproject/zephyr/soc/intel/panther_lake/Kconfig.defconfig"
osource "D:/ZephyrProject/mchp_zephyrproject/zephyr/soc/intel/lakemont/Kconfig.defconfig"
osource "D:/ZephyrProject/mchp_zephyrproject/zephyr/soc/intel/intel_socfpga_std/Kconfig.defconfig"
osource "D:/ZephyrProject/mchp_zephyrproject/zephyr/soc/intel/intel_socfpga/Kconfig.defconfig"
osource "D:/ZephyrProject/mchp_zephyrproject/zephyr/soc/intel/intel_niosv/Kconfig.defconfig"
osource "D:/ZephyrProject/mchp_zephyrproject/zephyr/soc/intel/intel_ish/Kconfig.defconfig"
osource "D:/ZephyrProject/mchp_zephyrproject/zephyr/soc/intel/intel_adsp/Kconfig.defconfig"
osource "D:/ZephyrProject/mchp_zephyrproject/zephyr/soc/intel/elkhart_lake/Kconfig.defconfig"
osource "D:/ZephyrProject/mchp_zephyrproject/zephyr/soc/intel/atom/Kconfig.defconfig"
osource "D:/ZephyrProject/mchp_zephyrproject/zephyr/soc/intel/apollo_lake/Kconfig.defconfig"
osource "D:/ZephyrProject/mchp_zephyrproject/zephyr/soc/intel/alder_lake/Kconfig.defconfig"
osource "D:/ZephyrProject/mchp_zephyrproject/zephyr/soc/infineon/psoc4/Kconfig.defconfig"
osource "D:/ZephyrProject/mchp_zephyrproject/zephyr/soc/infineon/edge/Kconfig.defconfig"
osource "D:/ZephyrProject/mchp_zephyrproject/zephyr/soc/infineon/cat3/Kconfig.defconfig"
osource "D:/ZephyrProject/mchp_zephyrproject/zephyr/soc/infineon/cat1c/Kconfig.defconfig"
osource "D:/ZephyrProject/mchp_zephyrproject/zephyr/soc/infineon/cat1b/Kconfig.defconfig"
osource "D:/ZephyrProject/mchp_zephyrproject/zephyr/soc/infineon/cat1a/Kconfig.defconfig"
osource "D:/ZephyrProject/mchp_zephyrproject/zephyr/soc/gd/gd32/Kconfig.defconfig"
osource "D:/ZephyrProject/mchp_zephyrproject/zephyr/soc/gaisler/leon3/Kconfig.defconfig"
osource "D:/ZephyrProject/mchp_zephyrproject/zephyr/soc/gaisler/gr716a/Kconfig.defconfig"
osource "D:/ZephyrProject/mchp_zephyrproject/zephyr/soc/focaltech/Kconfig.defconfig"
osource "D:/ZephyrProject/mchp_zephyrproject/zephyr/soc/espressif/Kconfig.defconfig"
osource "D:/ZephyrProject/mchp_zephyrproject/zephyr/soc/ene/kb1200/Kconfig.defconfig"
osource "D:/ZephyrProject/mchp_zephyrproject/zephyr/soc/ene/kb106x/Kconfig.defconfig"
osource "D:/ZephyrProject/mchp_zephyrproject/zephyr/soc/elan/em32f967/Kconfig.defconfig"
osource "D:/ZephyrProject/mchp_zephyrproject/zephyr/soc/egis/Kconfig.defconfig"
osource "D:/ZephyrProject/mchp_zephyrproject/zephyr/soc/efinix/sapphire/Kconfig.defconfig"
osource "D:/ZephyrProject/mchp_zephyrproject/zephyr/soc/cdns/xtensa_sample_controller/Kconfig.defconfig"
osource "D:/ZephyrProject/mchp_zephyrproject/zephyr/soc/cdns/swerv/Kconfig.defconfig"
osource "D:/ZephyrProject/mchp_zephyrproject/zephyr/soc/cdns/sample_controller32/Kconfig.defconfig"
osource "D:/ZephyrProject/mchp_zephyrproject/zephyr/soc/cdns/dc233c/Kconfig.defconfig"
osource "D:/ZephyrProject/mchp_zephyrproject/zephyr/soc/brcm/bcmvk/Kconfig.defconfig"
osource "D:/ZephyrProject/mchp_zephyrproject/zephyr/soc/brcm/bcm2712/Kconfig.defconfig"
osource "D:/ZephyrProject/mchp_zephyrproject/zephyr/soc/brcm/bcm2711/Kconfig.defconfig"
osource "D:/ZephyrProject/mchp_zephyrproject/zephyr/soc/blackberry/qnxhv_vm/Kconfig.defconfig"
osource "D:/ZephyrProject/mchp_zephyrproject/zephyr/soc/bflb/Kconfig.defconfig"
osource "D:/ZephyrProject/mchp_zephyrproject/zephyr/soc/atmel/sam0/Kconfig.defconfig"
osource "D:/ZephyrProject/mchp_zephyrproject/zephyr/soc/atmel/sam/Kconfig.defconfig"
osource "D:/ZephyrProject/mchp_zephyrproject/zephyr/soc/aspeed/Kconfig.defconfig"
osource "D:/ZephyrProject/mchp_zephyrproject/zephyr/soc/arm/Kconfig.defconfig"
osource "D:/ZephyrProject/mchp_zephyrproject/zephyr/soc/arm/beetle/Kconfig.defconfig"
osource "D:/ZephyrProject/mchp_zephyrproject/zephyr/soc/antmicro/myra/Kconfig.defconfig"
osource "D:/ZephyrProject/mchp_zephyrproject/zephyr/soc/andestech/Kconfig.defconfig"
osource "D:/ZephyrProject/mchp_zephyrproject/zephyr/soc/amd/acp_6_0/Kconfig.defconfig"
osource "D:/ZephyrProject/mchp_zephyrproject/zephyr/soc/ambiq/Kconfig.defconfig"
osource "D:/ZephyrProject/mchp_zephyrproject/zephyr/soc/allwinner/sun8i_h3/Kconfig.defconfig"
osource "D:/ZephyrProject/mchp_zephyrproject/zephyr/soc/alif/ensemble/Kconfig.defconfig"
osource "D:/ZephyrProject/mchp_zephyrproject/zephyr/soc/aesc/Kconfig.defconfig"
osource "D:/ZephyrProject/mchp_zephyrproject/zephyr/soc/adi/max32/Kconfig.defconfig"
```

## results/run_2026-07-23_23-30-28/build/hid_mouse_hs/Kconfig/arch/Kconfig
```kconfig
# Load Zephyr Arch Kconfig descriptions.
osource "D:/ZephyrProject/mchp_zephyrproject/zephyr/arch/rx/Kconfig"
osource "D:/ZephyrProject/mchp_zephyrproject/zephyr/arch/x86/Kconfig"
osource "D:/ZephyrProject/mchp_zephyrproject/zephyr/arch/xtensa/Kconfig"
osource "D:/ZephyrProject/mchp_zephyrproject/zephyr/arch/sparc/Kconfig"
osource "D:/ZephyrProject/mchp_zephyrproject/zephyr/arch/riscv/Kconfig"
osource "D:/ZephyrProject/mchp_zephyrproject/zephyr/arch/posix/Kconfig"
osource "D:/ZephyrProject/mchp_zephyrproject/zephyr/arch/openrisc/Kconfig"
osource "D:/ZephyrProject/mchp_zephyrproject/zephyr/arch/mips/Kconfig"
osource "D:/ZephyrProject/mchp_zephyrproject/zephyr/arch/arm64/Kconfig"
osource "D:/ZephyrProject/mchp_zephyrproject/zephyr/arch/arm/Kconfig"
osource "D:/ZephyrProject/mchp_zephyrproject/zephyr/arch/arc/Kconfig"
```
