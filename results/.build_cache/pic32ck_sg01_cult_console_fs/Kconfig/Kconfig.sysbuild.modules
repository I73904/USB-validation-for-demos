## results/.build_cache/pic32ck_sg01_cult_console_fs/Kconfig/Kconfig.sysbuild.modules
```kconfig
config ZEPHYR_MICROCHIP_ZSDK_MODULE
   bool
   default y
config ZEPHYR_MICROCHIP_MODULE
   bool
   default y
config ZEPHYR_CMSIS_MODULE
   bool
   default y
config ZEPHYR_CMSIS_DSP_MODULE
   bool
   default y
config ZEPHYR_CMSIS_NN_MODULE
   bool
   default y
config ZEPHYR_CMSIS_6_MODULE
   bool
   default y
config ZEPHYR_FATFS_MODULE
   bool
   default y
config ZEPHYR_ATMEL_MODULE
   bool
   default y
config ZEPHYR_LITTLEFS_MODULE
   bool
   default y
config ZEPHYR_LVGL_MODULE
   bool
   default y
config ZEPHYR_MBEDTLS_MODULE
   bool
   default y
config ZEPHYR_MCUBOOT_MODULE
   bool
   default y
config ZEPHYR_PICOLIBC_MODULE
   bool
   default y
config ZEPHYR_SEGGER_MODULE
   bool
   default y
config ZEPHYR_TF_PSA_CRYPTO_MODULE
   bool
   default y
config ZEPHYR_ZCBOR_MODULE
   bool
   default y
```

## results/.build_cache/pic32ck_sg01_cult_console_hs/Kconfig/boards/Kconfig.sysbuild.tmp
```kconfig
# Load Sysbuild board Kconfig descriptions.
osource "D:/ZephyrProject/mchp_zephyrproject/zephyr/boards/microchip/pic32c/pic32ck_sg01_cult/Kconfig.sysbuild"
```

## results/.build_cache/pic32ck_sg01_cult_shell_fs/Kconfig/soc/Kconfig.tmp
```kconfig
# Load Zephyr SoC Kconfig descriptions.
osource "D:/ZephyrProject/mchp_zephyrproject/zephyr/soc/xlnx/zynqmp/Kconfig"
osource "D:/ZephyrProject/mchp_zephyrproject/zephyr/soc/xlnx/zynq7000/Kconfig"
osource "D:/ZephyrProject/mchp_zephyrproject/zephyr/soc/xlnx/versalnet/Kconfig"
osource "D:/ZephyrProject/mchp_zephyrproject/zephyr/soc/xlnx/versal2/Kconfig"
osource "D:/ZephyrProject/mchp_zephyrproject/zephyr/soc/xlnx/versal/Kconfig"
osource "D:/ZephyrProject/mchp_zephyrproject/zephyr/soc/xen/Kconfig"
osource "D:/ZephyrProject/mchp_zephyrproject/zephyr/soc/wch/ch32v/Kconfig"
osource "D:/ZephyrProject/mchp_zephyrproject/zephyr/soc/ti/simplelink/Kconfig"
osource "D:/ZephyrProject/mchp_zephyrproject/zephyr/soc/ti/mspm0/Kconfig"
osource "D:/ZephyrProject/mchp_zephyrproject/zephyr/soc/ti/lm3s6965/Kconfig"
osource "D:/ZephyrProject/mchp_zephyrproject/zephyr/soc/ti/k3/Kconfig"
osource "D:/ZephyrProject/mchp_zephyrproject/zephyr/soc/telink/tlsr/Kconfig"
osource "D:/ZephyrProject/mchp_zephyrproject/zephyr/soc/syna/sr100/Kconfig"
osource "D:/ZephyrProject/mchp_zephyrproject/zephyr/soc/starfive/jh71xx/Kconfig"
osource "D:/ZephyrProject/mchp_zephyrproject/zephyr/soc/st/stm32/Kconfig"
osource "D:/ZephyrProject/mchp_zephyrproject/zephyr/soc/snps/qemu_arc/Kconfig"
osource "D:/ZephyrProject/mchp_zephyrproject/zephyr/soc/snps/nsim/arc_v/Kconfig"
osource "D:/ZephyrProject/mchp_zephyrproject/zephyr/soc/snps/nsim/arc_classic/Kconfig"
osource "D:/ZephyrProject/mchp_zephyrproject/zephyr/soc/snps/hsdk4xd/Kconfig"
osource "D:/ZephyrProject/mchp_zephyrproject/zephyr/soc/snps/hsdk/Kconfig"
osource "D:/ZephyrProject/mchp_zephyrproject/zephyr/soc/snps/emsk/Kconfig"
osource "D:/ZephyrProject/mchp_zephyrproject/zephyr/soc/snps/emsdp/Kconfig"
osource "D:/ZephyrProject/mchp_zephyrproject/zephyr/soc/snps/arc_iot/Kconfig"
osource "D:/ZephyrProject/mchp_zephyrproject/zephyr/soc/silabs/Kconfig"
osource "D:/ZephyrProject/mchp_zephyrproject/zephyr/soc/sifli/sf32/Kconfig"
osource "D:/ZephyrProject/mchp_zephyrproject/zephyr/soc/sifive/sifive_freedom/Kconfig"
osource "D:/ZephyrProject/mchp_zephyrproject/zephyr/soc/sensry/Kconfig"
osource "D:/ZephyrProject/mchp_zephyrproject/zephyr/soc/rockchip/Kconfig"
osource "D:/ZephyrProject/mchp_zephyrproject/zephyr/soc/renode/riscv_virtual/Kconfig"
osource "D:/ZephyrProject/mchp_zephyrproject/zephyr/soc/renode/cortex_r8_virtual/Kconfig"
osource "D:/ZephyrProject/mchp_zephyrproject/zephyr/soc/renesas/smartbond/Kconfig"
osource "D:/ZephyrProject/mchp_zephyrproject/zephyr/soc/renesas/rz/Kconfig"
osource "D:/ZephyrProject/mchp_zephyrproject/zephyr/soc/renesas/rx/Kconfig"
osource "D:/ZephyrProject/mchp_zephyrproject/zephyr/soc/renesas/rcar/Kconfig"
osource "D:/ZephyrProject/mchp_zephyrproject/zephyr/soc/renesas/ra/Kconfig"
osource "D:/ZephyrProject/mchp_zephyrproject/zephyr/soc/realtek/fingerprint/Kconfig"
osource "D:/ZephyrProject/mchp_zephyrproject/zephyr/soc/realtek/ec/Kconfig"
osource "D:/ZephyrProject/mchp_zephyrproject/zephyr/soc/realtek/bee/Kconfig"
osource "D:/ZephyrProject/mchp_zephyrproject/zephyr/soc/realtek/ameba/Kconfig"
osource "D:/ZephyrProject/mchp_zephyrproject/zephyr/soc/raspberrypi/rpi_pico/Kconfig"
osource "D:/ZephyrProject/mchp_zephyrproject/zephyr/soc/quicklogic/eos_s3/Kconfig"
osource "D:/ZephyrProject/mchp_zephyrproject/zephyr/soc/qemu/virt_riscv/Kconfig"
osource "D:/ZephyrProject/mchp_zephyrproject/zephyr/soc/qemu/or1k/Kconfig"
osource "D:/ZephyrProject/mchp_zephyrproject/zephyr/soc/qemu/malta/Kconfig"
osource "D:/ZephyrProject/mchp_zephyrproject/zephyr/soc/openisa/rv32m1/Kconfig"
osource "D:/ZephyrProject/mchp_zephyrproject/zephyr/soc/openhwgroup/cva6/Kconfig"
osource "D:/ZephyrProject/mchp_zephyrproject/zephyr/soc/oct/osd32mp15x/Kconfig"
osource "D:/ZephyrProject/mchp_zephyrproject/zephyr/soc/nxp/s32/Kconfig"
osource "D:/ZephyrProject/mchp_zephyrproject/zephyr/soc/nxp/rw/Kconfig"
osource "D:/ZephyrProject/mchp_zephyrproject/zephyr/soc/nxp/mcx/Kconfig"
osource "D:/ZephyrProject/mchp_zephyrproject/zephyr/soc/nxp/lpc/Kconfig"
osource "D:/ZephyrProject/mchp_zephyrproject/zephyr/soc/nxp/layerscape/Kconfig"
osource "D:/ZephyrProject/mchp_zephyrproject/zephyr/soc/nxp/kinetis/Kconfig"
osource "D:/ZephyrProject/mchp_zephyrproject/zephyr/soc/nxp/imxrt/Kconfig"
osource "D:/ZephyrProject/mchp_zephyrproject/zephyr/soc/nxp/imx/Kconfig"
osource "D:/ZephyrProject/mchp_zephyrproject/zephyr/soc/nuvoton/numicro/Kconfig"
osource "D:/ZephyrProject/mchp_zephyrproject/zephyr/soc/nuvoton/numaker/Kconfig"
osource "D:/ZephyrProject/mchp_zephyrproject/zephyr/soc/nuvoton/npcx/Kconfig"
osource "D:/ZephyrProject/mchp_zephyrproject/zephyr/soc/nuvoton/npcm/Kconfig"
osource "D:/ZephyrProject/mchp_zephyrproject/zephyr/soc/nordic/Kconfig"
osource "D:/ZephyrProject/mchp_zephyrproject/zephyr/soc/neorv32/Kconfig"
osource "D:/ZephyrProject/mchp_zephyrproject/zephyr/soc/native/inf_clock/Kconfig"
osource "D:/ZephyrProject/mchp_zephyrproject/zephyr/soc/microchip/sam/sama7/Kconfig"
osource "D:/ZephyrProject/mchp_zephyrproject/zephyr/soc/microchip/sam/sam_d5x_e5x/Kconfig"
osource "D:/ZephyrProject/mchp_zephyrproject/zephyr/soc/microchip/sam/sam9/Kconfig"
osource "D:/ZephyrProject/mchp_zephyrproject/zephyr/soc/microchip/pic64/Kconfig"
osource "D:/ZephyrProject/mchp_zephyrproject/zephyr/soc/microchip/pic32c/pic32cz_ca/Kconfig"
osource "D:/ZephyrProject/mchp_zephyrproject/zephyr/soc/microchip/pic32c/pic32cx_sg/Kconfig"
osource "D:/ZephyrProject/mchp_zephyrproject/zephyr/soc/microchip/pic32c/pic32cm_sg_gc/Kconfig"
osource "D:/ZephyrProject/mchp_zephyrproject/zephyr/soc/microchip/pic32c/pic32cm_pl/Kconfig"
osource "D:/ZephyrProject/mchp_zephyrproject/zephyr/soc/microchip/pic32c/pic32cm_jh/Kconfig"
osource "D:/ZephyrProject/mchp_zephyrproject/zephyr/soc/microchip/pic32c/pic32ck_sg_gc/Kconfig"
osource "D:/ZephyrProject/mchp_zephyrproject/zephyr/soc/microchip/miv/Kconfig"
osource "D:/ZephyrProject/mchp_zephyrproject/zephyr/soc/microchip/mec/Kconfig"
osource "D:/ZephyrProject/mchp_zephyrproject/zephyr/soc/mediatek/mt8xxx/Kconfig"
osource "D:/ZephyrProject/mchp_zephyrproject/zephyr/soc/lowrisc/opentitan/Kconfig"
osource "D:/ZephyrProject/mchp_zephyrproject/zephyr/soc/litex/litex_vexriscv/Kconfig"
osource "D:/ZephyrProject/mchp_zephyrproject/zephyr/soc/ite/ec/Kconfig"
osource "D:/ZephyrProject/mchp_zephyrproject/zephyr/soc/intel/wildcat_lake/Kconfig"
osource "D:/ZephyrProject/mchp_zephyrproject/zephyr/soc/intel/raptor_lake/Kconfig"
osource "D:/ZephyrProject/mchp_zephyrproject/zephyr/soc/intel/panther_lake/Kconfig"
osource "D:/ZephyrProject/mchp_zephyrproject/zephyr/soc/intel/lakemont/Kconfig"
osource "D:/ZephyrProject/mchp_zephyrproject/zephyr/soc/intel/intel_socfpga_std/Kconfig"
osource "D:/ZephyrProject/mchp_zephyrproject/zephyr/soc/intel/intel_socfpga/Kconfig"
osource "D:/ZephyrProject/mchp_zephyrproject/zephyr/soc/intel/intel_niosv/Kconfig"
osource "D:/ZephyrProject/mchp_zephyrproject/zephyr/soc/intel/intel_ish/Kconfig"
osource "D:/ZephyrProject/mchp_zephyrproject/zephyr/soc/intel/intel_adsp/Kconfig"
osource "D:/ZephyrProject/mchp_zephyrproject/zephyr/soc/intel/elkhart_lake/Kconfig"
osource "D:/ZephyrProject/mchp_zephyrproject/zephyr/soc/intel/atom/Kconfig"
osource "D:/ZephyrProject/mchp_zephyrproject/zephyr/soc/intel/apollo_lake/Kconfig"
osource "D:/ZephyrProject/mchp_zephyrproject/zephyr/soc/intel/alder_lake/Kconfig"
osource "D:/ZephyrProject/mchp_zephyrproject/zephyr/soc/infineon/psoc4/Kconfig"
osource "D:/ZephyrProject/mchp_zephyrproject/zephyr/soc/infineon/edge/Kconfig"
osource "D:/ZephyrProject/mchp_zephyrproject/zephyr/soc/infineon/cat3/Kconfig"
osource "D:/ZephyrProject/mchp_zephyrproject/zephyr/soc/infineon/cat1c/Kconfig"
osource "D:/ZephyrProject/mchp_zephyrproject/zephyr/soc/infineon/cat1b/Kconfig"
osource "D:/ZephyrProject/mchp_zephyrproject/zephyr/soc/infineon/cat1a/Kconfig"
osource "D:/ZephyrProject/mchp_zephyrproject/zephyr/soc/gd/gd32/Kconfig"
osource "D:/ZephyrProject/mchp_zephyrproject/zephyr/soc/gaisler/leon3/Kconfig"
osource "D:/ZephyrProject/mchp_zephyrproject/zephyr/soc/gaisler/gr716a/Kconfig"
osource "D:/ZephyrProject/mchp_zephyrproject/zephyr/soc/focaltech/Kconfig"
osource "D:/ZephyrProject/mchp_zephyrproject/zephyr/soc/espressif/Kconfig"
osource "D:/ZephyrProject/mchp_zephyrproject/zephyr/soc/ene/kb1200/Kconfig"
osource "D:/ZephyrProject/mchp_zephyrproject/zephyr/soc/ene/kb106x/Kconfig"
osource "D:/ZephyrProject/mchp_zephyrproject/zephyr/soc/elan/em32f967/Kconfig"
osource "D:/ZephyrProject/mchp_zephyrproject/zephyr/soc/egis/Kconfig"
osource "D:/ZephyrProject/mchp_zephyrproject/zephyr/soc/efinix/sapphire/Kconfig"
osource "D:/ZephyrProject/mchp_zephyrproject/zephyr/soc/cdns/xtensa_sample_controller/Kconfig"
osource "D:/ZephyrProject/mchp_zephyrproject/zephyr/soc/cdns/swerv/Kconfig"
osource "D:/ZephyrProject/mchp_zephyrproject/zephyr/soc/cdns/sample_controller32/Kconfig"
osource "D:/ZephyrProject/mchp_zephyrproject/zephyr/soc/cdns/dc233c/Kconfig"
osource "D:/ZephyrProject/mchp_zephyrproject/zephyr/soc/brcm/bcmvk/Kconfig"
osource "D:/ZephyrProject/mchp_zephyrproject/zephyr/soc/brcm/bcm2712/Kconfig"
osource "D:/ZephyrProject/mchp_zephyrproject/zephyr/soc/brcm/bcm2711/Kconfig"
osource "D:/ZephyrProject/mchp_zephyrproject/zephyr/soc/blackberry/qnxhv_vm/Kconfig"
osource "D:/ZephyrProject/mchp_zephyrproject/zephyr/soc/bflb/Kconfig"
osource "D:/ZephyrProject/mchp_zephyrproject/zephyr/soc/atmel/sam0/Kconfig"
osource "D:/ZephyrProject/mchp_zephyrproject/zephyr/soc/atmel/sam/Kconfig"
osource "D:/ZephyrProject/mchp_zephyrproject/zephyr/soc/aspeed/Kconfig"
osource "D:/ZephyrProject/mchp_zephyrproject/zephyr/soc/arm/Kconfig"
osource "D:/ZephyrProject/mchp_zephyrproject/zephyr/soc/arm/beetle/Kconfig"
osource "D:/ZephyrProject/mchp_zephyrproject/zephyr/soc/antmicro/myra/Kconfig"
osource "D:/ZephyrProject/mchp_zephyrproject/zephyr/soc/andestech/Kconfig"
osource "D:/ZephyrProject/mchp_zephyrproject/zephyr/soc/amd/acp_6_0/Kconfig"
osource "D:/ZephyrProject/mchp_zephyrproject/zephyr/soc/ambiq/Kconfig"
osource "D:/ZephyrProject/mchp_zephyrproject/zephyr/soc/allwinner/sun8i_h3/Kconfig"
osource "D:/ZephyrProject/mchp_zephyrproject/zephyr/soc/alif/ensemble/Kconfig"
osource "D:/ZephyrProject/mchp_zephyrproject/zephyr/soc/aesc/Kconfig"
osource "D:/ZephyrProject/mchp_zephyrproject/zephyr/soc/adi/max32/Kconfig"
```

## results/run_2026-07-23_15-54-52/build/console_hs/Kconfig/Kconfig.modules
```kconfig
menu "microchip-zsdk (D:/ZephyrProject/mchp_zephyrproject/microchip-zsdk)"
osource "D:/ZephyrProject/mchp_zephyrproject/microchip-zsdk/Kconfig"
config ZEPHYR_MICROCHIP_ZSDK_MODULE
	bool
	default y
endmenu
config ZEPHYR_MICROCHIP_MODULE
	bool
	default y
menu "cmsis (D:/ZephyrProject/mchp_zephyrproject/modules/hal/cmsis)"
osource "$(ZEPHYR_CMSIS_KCONFIG)"
config ZEPHYR_CMSIS_MODULE
	bool
	default y
endmenu
menu "cmsis-dsp (D:/ZephyrProject/mchp_zephyrproject/modules/lib/cmsis-dsp)"
osource "$(ZEPHYR_CMSIS_DSP_KCONFIG)"
config ZEPHYR_CMSIS_DSP_MODULE
	bool
	default y
endmenu
menu "cmsis-nn (D:/ZephyrProject/mchp_zephyrproject/modules/lib/cmsis-nn)"
osource "$(ZEPHYR_CMSIS_NN_KCONFIG)"
config ZEPHYR_CMSIS_NN_MODULE
	bool
	default y
endmenu
menu "cmsis_6 (D:/ZephyrProject/mchp_zephyrproject/modules/hal/cmsis_6)"
osource "$(ZEPHYR_CMSIS_6_KCONFIG)"
config ZEPHYR_CMSIS_6_MODULE
	bool
	default y
endmenu
menu "fatfs (D:/ZephyrProject/mchp_zephyrproject/modules/fs/fatfs)"
osource "$(ZEPHYR_FATFS_KCONFIG)"
config ZEPHYR_FATFS_MODULE
	bool
	default y
endmenu
config ZEPHYR_ATMEL_MODULE
	bool
	default y
menu "littlefs (D:/ZephyrProject/mchp_zephyrproject/modules/fs/littlefs)"
osource "$(ZEPHYR_LITTLEFS_KCONFIG)"
config ZEPHYR_LITTLEFS_MODULE
	bool
	default y
endmenu
menu "lvgl (D:/ZephyrProject/mchp_zephyrproject/modules/lib/gui/lvgl)"
osource "D:/ZephyrProject/mchp_zephyrproject/modules/lib/gui/lvgl/zephyr/Kconfig"
config ZEPHYR_LVGL_MODULE
	bool
	default y
endmenu
menu "mbedtls (D:/ZephyrProject/mchp_zephyrproject/modules/crypto/mbedtls)"
osource "$(ZEPHYR_MBEDTLS_KCONFIG)"
config ZEPHYR_MBEDTLS_MODULE
	bool
	default y
endmenu
config ZEPHYR_MCUBOOT_MODULE
	bool
	default y
menu "picolibc (D:/ZephyrProject/mchp_zephyrproject/modules/lib/picolibc)"
osource "D:/ZephyrProject/mchp_zephyrproject/modules/lib/picolibc/zephyr/Kconfig"
config ZEPHYR_PICOLIBC_MODULE
	bool
	default y
endmenu
menu "segger (D:/ZephyrProject/mchp_zephyrproject/modules/debug/segger)"
osource "$(ZEPHYR_SEGGER_KCONFIG)"
config ZEPHYR_SEGGER_MODULE
	bool
	default y
endmenu
config ZEPHYR_TF_PSA_CRYPTO_MODULE
	bool
	default y
menu "zcbor (D:/ZephyrProject/mchp_zephyrproject/modules/lib/zcbor)"
osource "$(ZEPHYR_ZCBOR_KCONFIG)"
config ZEPHYR_ZCBOR_MODULE
	bool
	default y
endmenu
```
